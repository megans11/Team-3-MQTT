// These arguments were used when this file was generated. They will be automatically applied on subsequent loads 
// via the GUI or CLI invocations. Run CLI with '--help' for additional information on how to override these arguments.
// @cliArgs --board "/ti/boards/CC3220SF_LAUNCHXL" --product "SimpleLinkSDK@3.20.00.06"
// @versions {"data":"2019051709","timestamp":"2019051709","tool":"1.1.792","templates":"2019051709"}

// Add a SENSORS BoosterPack boosterpack
var BOOSTXL_SENSORS = scripting.addHardware("/ti/boards/boosterpacks/BOOSTXL-SENSORS");
var SimpleLinkWifi = scripting.addModule("/ti/drivers/net/wifi/SimpleLinkWifi");
var Crypto = scripting.addModule("/ti/drivers/Crypto");
var Display = scripting.addModule("/ti/display/Display");
var DMA = scripting.addModule("/ti/drivers/DMA");
var GPIO = scripting.addModule("/ti/drivers/GPIO");
var Timer = scripting.addModule("/ti/drivers/Timer");
var Watchdog = scripting.addModule("/ti/drivers/Watchdog");
var Crypto1 = Crypto.addInstance();
var Display1 = Display.addInstance();
var GPIO1 = GPIO.addInstance();
var GPIO2 = GPIO.addInstance();
var GPIO3 = GPIO.addInstance();
var GPIO4 = GPIO.addInstance();
var GPIO5 = GPIO.addInstance();
var GPIO6 = GPIO.addInstance();
var GPIO7 = GPIO.addInstance();
var GPIO8 = GPIO.addInstance();
var Timer1 = Timer.addInstance();
var Timer2 = Timer.addInstance();
var Timer3 = Timer.addInstance();
var Watchdog1 = Watchdog.addInstance();
var GPIO9 = GPIO.addInstance();
var GPIO10 = GPIO.addInstance();
var GPIO11 = GPIO.addInstance();
var GPIO12 = GPIO.addInstance();
var GPIO13 = GPIO.addInstance();
var GPIO14 = GPIO.addInstance();
var Timer4 = Timer.addInstance();
var SPI = scripting.addModule("/ti/drivers/SPI");
var SPI1 = SPI.addInstance();
var Board = scripting.addModule("/ti/drivers/Board");
var Power = scripting.addModule("/ti/drivers/Power");
// IO Retention Shutdown - IO groups to be retained during Shutdown
Power.ioRetentionShutdown = ["GRP_1"];
// Name
Power.parkPins.$name = "ti_drivers_power_PowerCC32XXPins0";
// Name - The C/C++ identifier used in applications as the index parameter passed to Crypto runtime APIs
Crypto1.$name = "Board_Crypto0";
// Name - The C/C++ identifier used in applications as the index parameter passed to Display runtime APIs
Display1.$name = "Board_Display0";
// Use Hardware - Select the hardware to use, or 'none' to use available header pins
Display1.$hardware = system.deviceData.board.components.xds110Uart;
// Use DMA
Display1.uart.useDMA = true;
// Name - The C/C++ identifier used in applications as the index parameter passed to UART runtime APIs
Display1.uart.$name = "UART_USB";
// Name
Display1.uart.uart.$name = "MyUART1";
// Use Peripheral
Display1.uart.uart.$assign = "UART0";
// Assign pin
Display1.uart.uart.txPin.$assign = "GP01"; // pin number - 55
// Assign pin
Display1.uart.uart.rxPin.$assign = "GP02"; // pin number - 57
// Assign pin
Display1.uart.uart.txDmaChannel.$assign = "UDMA_CH9";
// Assign pin
Display1.uart.uart.rxDmaChannel.$assign = "UDMA_CH8";
// Use Hardware - Select the hardware to use, or 'none' to use available header pins
GPIO1.$hardware = system.deviceData.board.components.SW2;
// Name - The C/C++ identifier used in applications as the index parameter passed to GPIO runtime APIs
GPIO1.$name = "Board_GPIO_BUTTON0";
// Interrupt Trigger - Specifies when or if interrupts are triggered
GPIO1.interruptTrigger = "Rising Edge";
// Assign pin
GPIO1.gpioPin.$assign = "boosterpack.3"; // P04
// Name - The C/C++ identifier used in applications as the index parameter passed to GPIO runtime APIs
GPIO2.$name = "Board_GPIO_BUTTON1";
// Use Hardware - Select the hardware to use, or 'none' to use available header pins
GPIO2.$hardware = system.deviceData.board.components.SW3;
// Interrupt Trigger - Specifies when or if interrupts are triggered
GPIO2.interruptTrigger = "Rising Edge";
// Assign pin
GPIO2.gpioPin.$assign = "boosterpack.11"; // P15
// Name - The C/C++ identifier used in applications as the index parameter passed to GPIO runtime APIs
GPIO3.$name = "Board_GPIO_LED0";
// Use Hardware - Select the hardware to use, or 'none' to use available header pins
GPIO3.$hardware = system.deviceData.board.components.LED_RED;
// Output Strength
GPIO3.outputStrength = "High";
// Name - The C/C++ identifier used in applications as the index parameter passed to GPIO runtime APIs
GPIO4.$name = "Board_GPIO_LED1";
// Use Hardware - Select the hardware to use, or 'none' to use available header pins
GPIO4.$hardware = system.deviceData.board.components.LED_YELLOW;
// Output Strength
GPIO4.outputStrength = "High";
// Name - The C/C++ identifier used in applications as the index parameter passed to GPIO runtime APIs
GPIO5.$name = "Board_GPIO_LED2";
// Use Hardware - Select the hardware to use, or 'none' to use available header pins
GPIO5.$hardware = system.deviceData.board.components.LED_GREEN;
// Output Strength
GPIO5.outputStrength = "High";
// Name - The C/C++ identifier used in applications as the index parameter passed to GPIO runtime APIs
GPIO6.$name = "Board_GPIO0";
// Mode - Select the GPIO mode
GPIO6.mode = "Dynamic";
// Assign pin
GPIO6.gpioPin.$assign = "boosterpack.19"; // P18
// Name - The C/C++ identifier used in applications as the index parameter passed to GPIO runtime APIs
GPIO7.$name = "Board_GPIO1";
// Mode - Select the GPIO mode
GPIO7.mode = "Dynamic";
// Assign pin
GPIO7.gpioPin.$assign = "boosterpack.2"; // P58*
// Name - The C/C++ identifier used in applications as the index parameter passed to GPIO runtime APIs
GPIO8.$name = "Board_GPIO2";
// Mode - Select the GPIO mode
GPIO8.mode = "Dynamic";
// Assign pin
GPIO8.gpioPin.$assign = "boosterpack.4"; // P03
// Name - The C/C++ identifier used in applications as the index parameter passed to Timer runtime APIs
Timer1.$name = "Board_TIMER0";
// Timer Type
Timer1.timerType = "32 Bits";
// Name
Timer1.timer.$name = "MyTimer1";
// Use Peripheral
Timer1.timer.$assign = "Timer0";
// Name - The C/C++ identifier used in applications as the index parameter passed to Timer runtime APIs
Timer2.$name = "Board_TIMER1";
// Name
Timer2.timer.$name = "MyTimer1";
// Use Peripheral
Timer2.timer.$assign = "Timer1";
// Name - The C/C++ identifier used in applications as the index parameter passed to Timer runtime APIs
Timer3.$name = "Board_TIMER2";
// Name
Timer3.timer.$name = "MyTimer1";
// Use Peripheral
Timer3.timer.$assign = "Timer1";
// Name - The C/C++ identifier used in applications as the index parameter passed to Watchdog runtime APIs
Watchdog1.$name = "Board_WATCHDOG0";
// Name
Watchdog1.watchdog.$name = "MyWATCHDOG1";
// Use Peripheral
Watchdog1.watchdog.$assign = "WATCHDOG0";
// Name - The C/C++ identifier used in applications as the index parameter passed to GPIO runtime APIs
GPIO9.$name = "DEBUG_0";
// Name - The C/C++ identifier used in applications as the index parameter passed to GPIO runtime APIs
GPIO10.$name = "DEBUG_1";
// Name - The C/C++ identifier used in applications as the index parameter passed to GPIO runtime APIs
GPIO11.$name = "DEBUG_2";
// Name - The C/C++ identifier used in applications as the index parameter passed to GPIO runtime APIs
GPIO12.$name = "DEBUG_3";
// Name - The C/C++ identifier used in applications as the index parameter passed to GPIO runtime APIs
GPIO13.$name = "DEBUG_4";
// Name - The C/C++ identifier used in applications as the index parameter passed to GPIO runtime APIs
GPIO14.$name = "DEBUG_STATUS";
// Name - The C/C++ identifier used in applications as the index parameter passed to Timer runtime APIs
Timer4.$name = "TEST_TIMER";
// Timer Type
Timer4.timerType = "32 Bits";
// Name
Timer4.timer.$name = "MyTimer1";
// Name - The C/C++ identifier used in applications as the index parameter passed to SPI runtime APIs
SPI1.$name = "Board_SPI0";
// Mode - In three pin mode the SS signal is not used.
SPI1.mode = "Four Pin SS Active Low";
// Name
SPI1.spi.$name = "MySPI1";
// Suggest solution
GPIO3.gpioPin.$suggestSolution = "64";
// Suggest solution
GPIO4.gpioPin.$suggestSolution = "1";
// Suggest solution
GPIO5.gpioPin.$suggestSolution = "2";
// Suggest solution
GPIO9.gpioPin.$suggestSolution = "8";
// Suggest solution
GPIO10.gpioPin.$suggestSolution = "45";
// Suggest solution
GPIO11.gpioPin.$suggestSolution = "53";
// Suggest solution
GPIO12.gpioPin.$suggestSolution = "59";
// Suggest solution
GPIO13.gpioPin.$suggestSolution = "60";
// Suggest solution
GPIO14.gpioPin.$suggestSolution = "63";
// Suggest solution
Timer4.timer.$suggestSolution = "Timer2";
// Suggest solution
SPI1.spi.$suggestSolution = "SPI0";
// Suggest solution
SPI1.spi.sclkPin.$suggestSolution = "5";
// Suggest solution
SPI1.spi.misoPin.$suggestSolution = "6";
// Suggest solution
SPI1.spi.mosiPin.$suggestSolution = "7";
// Suggest solution
SPI1.spi.ssPin.$suggestSolution = "50";
// Suggest solution
SPI1.spi.dmaRxChannel.$suggestSolution = "UDMA_CH30";
// Suggest solution
SPI1.spi.dmaTxChannel.$suggestSolution = "UDMA_CH31";
